## esp32_bridge/sdkconfig.defaults
```kconfig
CONFIG_HTTPD_WS_SUPPORT=y

# Flash / Partitions
CONFIG_ESPTOOLPY_FLASHSIZE_4MB=y
CONFIG_PARTITION_TABLE_CUSTOM=y
CONFIG_PARTITION_TABLE_CUSTOM_FILENAME="partitions.csv"

# Bluetooth disabled — see project_no_ble.md
CONFIG_BT_ENABLED=n
```
